## components/ble_bridge/Kconfig
```kconfig
menu "BLE Bridge (Nordic UART Service)"

    config BLE_DEVICE_NAME
        string "Advertised BLE device name"
        default "DMR-RADIO"
        help
            GAP device name advertised by the Nordic UART Service peripheral.
            Clients filter/connect to this name.

endmenu
```

## components/msg_router/Kconfig
```kconfig
menu "Message Router"

    config MSG_ROUTER_BUF_SIZE
        int "Routing ring buffer size (bytes)"
        default 8192
        range 512 65536
        help
            Size of the FreeRTOS ring buffer that queues frames between all
            interfaces. Holds a small header plus the payload per frame.

    config MSG_ROUTER_SINK_QUEUE_SIZE
        int "Per-sink delivery queue size (bytes)"
        default 4096
        range 256 16384
        help
            Each registered sink gets its own ring buffer of this size. The
            routing task pushes frames into it non-blocking; when a sink is
            slow and its queue fills, new frames to THAT sink are dropped
            (drop-newest) so other sinks and producers are never blocked.

    config MSG_ROUTER_SINK_TASK_STACK
        int "Per-sink delivery task stack (bytes)"
        default 3072
        range 1024 8192
        help
            Stack for each sink's dedicated delivery task (one task per
            registered sink).

    config MSG_ROUTER_STATS_PERIOD_MS
        int "Drop-stats log period (ms)"
        default 30000
        range 0 3600000
        help
            How often to log cumulative per-interface drop counters (central
            buffer drops per source + per-sink queue drops per destination).
            Only logs when a counter changed since the last log. Set to 0 to
            disable the periodic log -- counters are still kept and readable on
            demand via msg_router_log_stats().

endmenu
```

## components/nordic_uart_multi/Kconfig
```kconfig
menu "Nordic UART (multi-connection) Configuration"

    config NORDIC_UART_RX_BUFFER_SIZE
        int "BLE RX ring buffer size (bytes)"
        default 4096
        range 256 65536
        help
            Size of the FreeRTOS ring buffer that holds incoming BLE data
            (one item per write, tagged with the source connection handle).

endmenu
```

## components/uart_bridge/Kconfig
```kconfig
menu "UART Bridge"

    menu "UART Radio (AT, auto-baud 9600/115200)"
        config UART_RADIO_NUM
            int "UART peripheral number"
            default 1
            range 0 2
            help
                Which UART controller to use for the Radio AT link.
                UART0 is usually the log console, so prefer UART1 or UART2.

        config UART_RADIO_TX_GPIO
            int "TX GPIO"
            default 17
            range 0 48
            help
                GPIO connected to the Radio's RX line.

        config UART_RADIO_RX_GPIO
            int "RX GPIO"
            default 18
            range 0 48
            help
                GPIO connected to the Radio's TX line.

        config UART_RADIO_BUF_SIZE
            int "RX scratch buffer size (bytes)"
            default 512
            range 128 4096

        config UART_RADIO_STARTUP_DELAY_MS
            int "Delay before first probe (ms)"
            default 5000
            range 0 60000
            help
                How long to wait after boot before the auto-baud task starts
                probing the AT radio link (lets USB/BLE settle first).

        config UART_RADIO_PROBE_ATTEMPTS
            int "Max probe attempts"
            default 3
            range 1 20
            help
                Number of full baud-probing rounds (each round tries 9600 then
                115200 with an "AT"->"OK" + "AT+SYNCOVER"->"OK" exchange). After
                this many failed rounds the radio bridge stays disabled instead
                of retrying forever.
    endmenu

    menu "UART Lora (fixed baud)"
        config UART_LORA_NUM
            int "UART peripheral number"
            default 2
            range 0 2
            help
                Which UART controller to use for the Lora link.
                Must differ from the Radio UART peripheral.

        config UART_LORA_TX_GPIO
            int "TX GPIO"
            default 21
            range 0 48
            help
                GPIO connected to the Lora module's RX line.

        config UART_LORA_RX_GPIO
            int "RX GPIO"
            default 47
            range 0 48
            help
                GPIO connected to the Lora module's TX line.

        config UART_LORA_BAUDRATE
            int "Baud rate"
            default 9600
            range 1200 5000000
            help
                Fixed baud rate for the Lora link (default 9600).

        config UART_LORA_BUF_SIZE
            int "RX scratch buffer size (bytes)"
            default 512
            range 128 4096
    endmenu

endmenu
```

## components/usb_cdc/Kconfig
```kconfig
menu "USB CDC (radio)"

    config USB_CDC_DEVICE_VID
        hex "USB Vendor ID"
        default 0x1FC9
        range 0x0000 0xFFFF
        help
            VID of the CDC-ACM device to open. Default is NXP/Tyt MD-9600.

    config USB_CDC_DEVICE_PID
        hex "USB Product ID"
        default 0x0094
        range 0x0000 0xFFFF
        help
            PID of the CDC-ACM device to open. Default is the MD-9600 CDC
            interface.

    config USB_CDC_BAUDRATE
        int "Line coding baud rate"
        default 115200
        range 1200 4000000
        help
            DTE rate applied via cdc_acm_host_line_coding_set() (8 data bits,
            no parity, 1 stop bit).

    config USB_CDC_TX_TIMEOUT_MS
        int "CDC TX blocking timeout (ms)"
        default 1000
        range 100 10000
        help
            How long the USB CDC sink waits for a bulk TX to complete before
            giving up on a frame. It is held under cdc_mutex, so this also
            bounds how long a disconnect handler is delayed.

endmenu
```
